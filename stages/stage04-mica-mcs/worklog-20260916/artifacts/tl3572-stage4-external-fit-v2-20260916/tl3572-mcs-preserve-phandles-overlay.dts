/dts-v1/;
/plugin/;

/ {
	fragment@0 {
		target-path = "/reserved-memory";

		__overlay__ {
			mcs_rmem: mcs-rmem@134000000 {
				reg = <0x1 0x34000000 0x0 0x04000000>;
				no-map;
			};
		};
	};

	fragment@1 {
		target-path = "/";

		__overlay__ {
			mcs_remoteproc: mcs-remoteproc {
				compatible = "oe,mcs_remoteproc";
				memory-region = <&mcs_rmem>;
			};
		};
	};
};
