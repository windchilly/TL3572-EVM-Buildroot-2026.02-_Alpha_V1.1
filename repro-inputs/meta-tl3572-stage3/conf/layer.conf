## repro-inputs/meta-tl3572-stage3/conf/layer.conf
```bitbake
BBPATH .= ":${LAYERDIR}"
BBFILES += "${LAYERDIR}/recipes-*/*/*.bb ${LAYERDIR}/recipes-*/*/*.bbappend"

BBFILE_COLLECTIONS += "tl3572"
BBFILE_PATTERN_tl3572 = "^${LAYERDIR}/"
BBFILE_PRIORITY_tl3572 = "20"
LAYERSERIES_COMPAT_tl3572 = "kirkstone"
```

## repro-inputs/stage01-05/stage02/meta-tl3572/conf/layer.conf
```bitbake
BBPATH .= ":${LAYERDIR}"
BBFILES += "${LAYERDIR}/recipes-*/*/*.bb ${LAYERDIR}/recipes-*/*/*.bbappend"

BBFILE_COLLECTIONS += "tl3572_stage2"
BBFILE_PATTERN_tl3572_stage2 = "^${LAYERDIR}/"
BBFILE_PRIORITY_tl3572_stage2 = "20"
LAYERSERIES_COMPAT_tl3572_stage2 = "kirkstone"
```

## stages/stage07-peripheral-partition/source/yocto/meta-tl3572-m7/conf/layer.conf
```bitbake
BBPATH .= ":${LAYERDIR}"
BBFILES += "${LAYERDIR}/recipes-*/*/*.bbappend"

BBFILE_COLLECTIONS += "tl3572m7"
BBFILE_PATTERN_tl3572m7 = "^${LAYERDIR}/"
BBFILE_PRIORITY_tl3572m7 = "21"
LAYERDEPENDS_tl3572m7 = "core tl3572"
LAYERSERIES_COMPAT_tl3572m7 = "kirkstone"
```
